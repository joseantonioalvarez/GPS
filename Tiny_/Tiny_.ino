#include <TinyGPS++.h>
#include <SoftwareSerial.h>
#include <ESP8266WiFi.h>
#include <Adafruit_SSD1306.h>  

Adafruit_SSD1306 display(128, 64); 

static const int RXPin = 12, TXPin = 13;
static const uint32_t GPSBaud = 9600;

TinyGPSPlus gps;
SoftwareSerial ss(RXPin, TXPin);

#define ID_Wifi "JOSE HOME [Planta1*]"
#define PWD_Wifi "josejosehomehome"
#define IP "184.106.153.149" //IP THINGSPEAK
String writeAPIKey = "ZPBBEFIMDCPRMZOK";

String lati= "";
String longi= "";

int sonido=0;
int dia=0;
int mes=0;
int anin=0;
int hora = 0;
int minuto=0;

const unsigned char PROGMEM jose2 [] = {
0x00, 0x00, 0x00, 0x00, 0x00, 0x00, 0x00, 0x00, 0x00, 0x00, 0x00, 0x00, 0x00, 0x00, 0x00, 0x00,
0x00, 0x00, 0x00, 0x00, 0x00, 0x00, 0x00, 0x00, 0x00, 0x00, 0x00, 0x00, 0x07, 0xFF, 0xFF, 0xFF,
0xFF, 0xFF, 0xC0, 0x0F, 0xFF, 0xFF, 0xFF, 0xFF, 0xFF, 0xE0, 0x0F, 0xFF, 0xFF, 0xFF, 0xFF, 0xFF,
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0x00, 0x00, 0x00, 0x00, 0x00, 0x00, 0x00, 0x00,
};

void setup(){
  Serial.begin(115200);
  ss.begin(GPSBaud);
  display.begin(SSD1306_SWITCHCAPVCC, 0x3C);  
  display.clearDisplay(); 
  display.setTextColor(WHITE);  
  display.setRotation(0);  
  display.setTextWrap(false);  
  display.dim(0); 
  display.drawBitmap(36, 0, jose2, 56, 56, 1);
  display.display();
  display.drawLine(32, 60, 35, 60, WHITE);
  display.display();
  delay(90);
  display.drawLine(32, 60, 45, 60, WHITE);
  display.display();
  delay(90);
  display.drawLine(32, 60, 55, 60, WHITE);
  display.display();
  delay(120);
  display.drawLine(32, 60, 65, 60, WHITE);
  display.display();
  delay(90);
  display.drawLine(32, 60, 75, 60, WHITE);
  display.display();
  delay(110);
  display.drawLine(32, 60, 85, 60, WHITE);
  display.display();
  delay(70);
  display.drawLine(32, 60, 93, 60, WHITE);
  display.display();  
   
  //------------------Hacer la conexión a la red----------
  if(WiFi.begin(ID_Wifi,PWD_Wifi))
  {
    Serial.println("Conexion AP OK\r\n");
    Serial.println("IP: ");
    Serial.println(WiFi.localIP());
  }
  else
  {
    Serial.println("Error al conectarse AP \r\n"); 
  }
  //-----------------------------------------------------
 delay(4000); 
}

void loop(){
  // This sketch displays information every time a new sentence is correctly encoded.
  while (ss.available() > 0)
    if (gps.encode(ss.read()))
      displayInfo();

  if (millis() > 5000 && gps.charsProcessed() < 10)
  {
    Serial.println(F("No GPS detected: check wiring."));
    while(true);
  }
}

void displayInfo(){
  if (gps.location.isValid() && gps.date.isValid() && gps.time.isValid()){

    double latitude = (gps.location.lat());
    double longitude = (gps.location.lng());

    lati = "";
    longi = "";
    
    lati += (String(latitude, 6));
    Serial.println(lati);

    longi += (String(longitude, 6));
    Serial.println(longi);

    dia = gps.date.day();
    mes= gps.date.month();
    anin= gps.date.year();
    Serial.print(dia);
    Serial.print(F("/"));
    Serial.print(mes);
    Serial.print(F("/"));
    Serial.println(anin);

    hora = gps.time.hour() + 1;
    minuto = gps.time.minute();
    if (hora < 10) Serial.print(F("0"));
    Serial.print(hora);
    Serial.print(F(":"));
    if (minuto < 10) Serial.print(F("0"));
    Serial.println(minuto);
    
    display.setTextSize(2);  
    display.setCursor(17, 0);  // (x,y)
    display.println(hora + ":" + minuto); 
    display.display();
  
    actualizaDatos ();
    delay(20000);
    
  }
  else{
    Serial.print(F("INVALID"));
    display.setTextSize(2);  
    display.setCursor(18, 19);  // (x,y)
    display.println("Buscando"); 
    display.setCursor(13, 34);  // (x,y)
    display.println("satelites"); 
    display.display();
  }

}
//--------------Función para enviar a ThingSpeak-------
void actualizaDatos (){
  WiFiClient Web;
  if (Web.connect(IP, 80))
  {
   Serial.println("Conexion TCP OK \r\n");
  }
  else
  {
   Serial.println("Conexion TCP error\r\n");
  }
  String EnviaDatos = "GET /update?key="+ writeAPIKey + "&field1=" + longi + "&field2=" + lati + "&field3=" + sonido + "&field4=" + dia + "&field5=" + mes + "&field6=" + anin + "&field7=" + hora + "&field8=" + minuto +  "\r\n";
  Web.print (EnviaDatos);
  Serial.println (EnviaDatos);
}
//---------------------------------------------------------
